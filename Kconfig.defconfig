## Kconfig.defconfig
```kconfig
# SPDX-License-Identifier: Apache-2.0

if BOARD_SSCI_MDBT53_DEV_BOARD_NRF5340_CPUAPP || BOARD_SSCI_MDBT53_DEV_BOARD_NRF5340_CPUAPP_NS

config BOARD_SSCI_MDBT53_DEV_BOARD
	select USE_DT_CODE_PARTITION if BOARD_SSCI_MDBT53_DEV_BOARD_NRF5340_CPUAPP_NS

config BT_HCI_IPC
	default y if BT_HCI

config HEAP_MEM_POOL_ADD_SIZE_BOARD
	int
	default 4096 if BT_HCI_IPC

endif
```

## Kconfig.ssci_mdbt53_dev_board
```kconfig
config BOARD_SSCI_MDBT53_DEV_BOARD
	select SOC_NRF5340_CPUAPP_QKAA if BOARD_SSCI_MDBT53_DEV_BOARD_NRF5340_CPUAPP
	select SOC_NRF5340_CPUAPP_QKAA if BOARD_SSCI_MDBT53_DEV_BOARD_NRF5340_CPUAPP_NS
	select SOC_NRF5340_CPUNET_QKAA if BOARD_SSCI_MDBT53_DEV_BOARD_NRF5340_CPUNET
```

## board.yml
```yaml
board:
  name: ssci_mdbt53_dev_board
  full_name: Switch Science MDBT53-1M nRF5340 Development Board
  vendor: ssci
  socs:
    - name: nrf5340
      variants:
        - name: ns
          cpucluster: cpuapp
```
